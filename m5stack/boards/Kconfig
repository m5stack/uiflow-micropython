## m5stack/boards/Kconfig
```kconfig
menu "Audio Board Configuration"

    config CORES3
        bool "select CORES3"
        default n
        help
            Enable this option to support m5stack cores3.

    config TAB5
        bool "select M5STACK TAB5"
        default n
        help
            Enable this option to support m5stack tab5.

    config ATOM_ECHOS3R
        bool "select M5STACK ATOM ECHOS3R"
        default n
        help
            Enable this option to support m5stack atom_echos3r.

    config STICKS3
        bool "select M5STACK STICKS3"
        default n
        help
            Enable this option to support m5stack sticks3.

endmenu
```

## third-party/boards/Kconfig
```kconfig
menu "Audio Board Configuration"

    config ESP32_S3_BOX_3_BOARD
        bool "select BOX-3"
        default y
        help
            Enable this option to support codec ES8311.
endmenu
```
